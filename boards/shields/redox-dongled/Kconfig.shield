## boards/shields/redox-dongled/Kconfig.shield
```kconfig
# Copyright (c) 2021 The ZMK Contributors
# SPDX-License-Identifier: MIT
config SHIELD_REDOX_DONGLED_LEFT
    def_bool $(shields_list_contains,redox-dongled_left)

config SHIELD_REDOX_DONGLED_RIGHT
    def_bool $(shields_list_contains,redox-dongled_right)

config SHIELD_REDOX_DONGLED_DONGLE
    def_bool $(shields_list_contains,redox-dongled_dongle)
```
